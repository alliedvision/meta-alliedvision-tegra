## conf/machine/include/tegra-avt-common.inc
```bitbake
PREFERRED_VERSION_nvidia-kernel-oot = "36.4.3-avt"

MACHINE_EXTRA_RDEPENDS:append = " avt-csi2 avt-csi2-overlays "
```

## conf/machine/jetson-orin-nano-devkit-alvium-nvme.conf
```bitbake
require conf/machine/jetson-orin-nano-devkit-nvme.conf

require conf/machine/include/tegra-avt-common.inc

TEGRA_PLUGIN_MANAGER_OVERLAYS:append = " tegra234-p3767-camera-p3768-alvium-dual-19623-1x2-1x4.dtbo "
```
